## boards/shields/corne_oled/Kconfig.defconfig
```kconfig
# Copyright (c) 2026 Fabricio Pecanha
# SPDX-License-Identifier: MIT

if SHIELD_CORNE_OLED

choice ZMK_DISPLAY_STATUS_SCREEN
    default ZMK_DISPLAY_STATUS_SCREEN_CUSTOM
endchoice

choice ZMK_DISPLAY_WORK_QUEUE
    default ZMK_DISPLAY_WORK_QUEUE_DEDICATED
endchoice

config ZMK_DISPLAY_DEDICATED_THREAD_STACK_SIZE
    default 2048

config ZMK_DISPLAY_DEDICATED_THREAD_PRIORITY
    default 5

config LV_Z_BITS_PER_PIXEL
    default 1

choice LV_COLOR_DEPTH
    default LV_COLOR_DEPTH_1
endchoice

endif
```

## boards/shields/corne_oled/Kconfig.shield
```kconfig
# Copyright (c) 2026 Fabricio Pecanha
# SPDX-License-Identifier: MIT

config SHIELD_CORNE_OLED
    def_bool $(shields_list_contains,corne_oled)
    select LV_USE_CANVAS
```

## config/west.yml
```yaml
manifest:
  remotes:
    - name: zmkfirmware
      url-base: https://github.com/zmkfirmware
    - name: fabriciopecanha
      url-base: https://github.com/fabriciopecanha
    # Additional modules containing boards/shields/custom code can be listed here as well
    # See https://docs.zephyrproject.org/3.2.0/develop/west/manifest.html#projects
  projects:
    - name: zmk
      remote: zmkfirmware
      revision: v0.3
      import: app/west.yml
    - name: zmk-nice-oled
      remote: fabriciopecanha
      revision: 51daf40edbab5f96601098e31c912976e45426c2
  self:
    path: config
```

## dts/bindings/behaviors/fp,behavior-layer-hold.yaml
```yaml
description: Momentary layer hold cooperating with the FP volatile layer lock
compatible: "fp,behavior-layer-hold"
include: one_param.yaml
```

## dts/bindings/behaviors/fp,behavior-layer-lock.yaml
```yaml
description: Toggle the FP volatile lock of an already active MOUSE or NAV layer
compatible: "fp,behavior-layer-lock"
include: one_param.yaml
```
